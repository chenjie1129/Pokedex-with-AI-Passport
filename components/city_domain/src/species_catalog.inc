// Generated by tools/generate_species.py.
static const city_species_definition_t species_definitions[CITY_SPECIES_COUNT] = {
    {.species_id=1, .name="Bulbasaur", .element="Grass", .type_label="Grass / Poison", .type1=5, .type2=8, .description="The seed on its back stores food to help it grow.", .base_hp=45, .base_attack=49, .base_defense=49, .place_pool=0, .wild_eligible=true, .place_eligible=true, .evolves_from=0},
    {.species_id=4, .name="Charmander", .element="Fire", .type_label="Fire", .type1=2, .type2=0, .description="The flame on its tail gets dim when it feels weak.", .base_hp=39, .base_attack=52, .base_defense=43, .place_pool=1, .wild_eligible=false, .place_eligible=true, .evolves_from=0},
    {.species_id=7, .name="Squirtle", .element="Water", .type_label="Water", .type1=3, .type2=0, .description="Its shell gets hard as it grows. It can spray strong foam.", .base_hp=44, .base_attack=48, .base_defense=65, .place_pool=2, .wild_eligible=true, .place_eligible=true, .evolves_from=0},
    {.species_id=25, .name="Pikachu", .element="Electric", .type_label="Electric", .type1=4, .type2=0, .description="It keeps electric power in its cheeks.", .base_hp=35, .base_attack=55, .base_defense=40, .place_pool=1, .wild_eligible=false, .place_eligible=true, .evolves_from=0},
    {.species_id=39, .name="Jigglypuff", .element="Normal", .type_label="Normal / Fairy", .type1=1, .type2=18, .description="Its soft song can make others fall asleep.", .base_hp=115, .base_attack=45, .base_defense=20, .place_pool=2, .wild_eligible=true, .place_eligible=true, .evolves_from=0},
    {.species_id=43, .name="Oddish", .element="Grass", .type_label="Grass / Poison", .type1=5, .type2=8, .description="At night, it walks on its two roots.", .base_hp=45, .base_attack=50, .base_defense=55, .place_pool=0, .wild_eligible=true, .place_eligible=true, .evolves_from=0},
    {.species_id=52, .name="Meowth", .element="Normal", .type_label="Normal", .type1=1, .type2=0, .description="It rests in the day and walks around its home at night.", .base_hp=40, .base_attack=45, .base_defense=35, .place_pool=1, .wild_eligible=true, .place_eligible=true, .evolves_from=0},
    {.species_id=54, .name="Psyduck", .element="Water", .type_label="Water", .type1=3, .type2=0, .description="When its head hurts badly, strange powers can come out.", .base_hp=50, .base_attack=52, .base_defense=48, .place_pool=2, .wild_eligible=true, .place_eligible=true, .evolves_from=0},
    {.species_id=58, .name="Growlithe", .element="Fire", .type_label="Fire", .type1=2, .type2=0, .description="It is brave, even against much bigger Pokemon.", .base_hp=55, .base_attack=70, .base_defense=45, .place_pool=1, .wild_eligible=false, .place_eligible=true, .evolves_from=0},
    {.species_id=74, .name="Geodude", .element="Rock", .type_label="Rock / Ground", .type1=13, .type2=9, .description="It looks like a rock. Watch where you step!", .base_hp=40, .base_attack=80, .base_defense=100, .place_pool=0, .wild_eligible=false, .place_eligible=true, .evolves_from=0},
    {.species_id=92, .name="Gastly", .element="Ghost", .type_label="Ghost / Poison", .type1=14, .type2=8, .description="Its body is made of gas. It can wrap around others.", .base_hp=30, .base_attack=35, .base_defense=30, .place_pool=0, .wild_eligible=false, .place_eligible=true, .evolves_from=0},
    {.species_id=133, .name="Eevee", .element="Normal", .type_label="Normal", .type1=1, .type2=0, .description="It can evolve into many forms to live in different places.", .base_hp=55, .base_attack=55, .base_defense=50, .place_pool=2, .wild_eligible=false, .place_eligible=true, .evolves_from=0},
    {.species_id=2, .name="Ivysaur", .element="Grass", .type_label="Grass / Poison", .type1=5, .type2=8, .description="Sunlight helps it grow strong and makes its back bud grow.", .base_hp=60, .base_attack=62, .base_defense=63, .place_pool=0, .wild_eligible=false, .place_eligible=false, .evolves_from=1},
    {.species_id=5, .name="Charmeleon", .element="Fire", .type_label="Fire", .type1=2, .type2=0, .description="Its hot tail can warm the air around it.", .base_hp=58, .base_attack=64, .base_defense=58, .place_pool=1, .wild_eligible=false, .place_eligible=false, .evolves_from=4},
    {.species_id=8, .name="Wartortle", .element="Water", .type_label="Water", .type1=3, .type2=0, .description="Its fluffy tail is a sign of a long life.", .base_hp=59, .base_attack=63, .base_defense=80, .place_pool=2, .wild_eligible=false, .place_eligible=false, .evolves_from=7},
    {.species_id=60000, .name="Mossbit", .element="Grass", .type_label="Grass", .type1=5, .type2=0, .description="A tiny moss spirit that rests beside quiet paths.", .base_hp=45, .base_attack=40, .base_defense=50, .place_pool=0, .wild_eligible=false, .place_eligible=false, .evolves_from=0},
};
